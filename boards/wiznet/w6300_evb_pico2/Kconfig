## boards/wiznet/w6300_evb_pico2/Kconfig
```kconfig
# Copyright (c) 2026 SUZINEE
# SPDX-License-Identifier: Apache-2.0

config BOARD_W6300_EVB_PICO2
	select RP2_FLASH_W25Q080
```

## boards/wiznet/w6300_evb_pico2/Kconfig.w6300_evb_pico2
```kconfig
# Copyright (c) 2025 TOKITA Hiroshi
# SPDX-License-Identifier: Apache-2.0

config BOARD_W6300_EVB_PICO2
	select SOC_RP2350A_HAZARD3 if BOARD_W6300_EVB_PICO2_RP2350A_HAZARD3
```

## boards/wiznet/w6300_evb_pico2/board.yml
```yaml
# Copyright (c) 2026 SUZINEE
# SPDX-License-Identifier: Apache-2.0

board:
  name: w6300_evb_pico2
  full_name: W6300-EVB-Pico2
  vendor: wiznet
  socs:
  - name: rp2350a
```

## boards/wiznet/w6300_evb_pico2/w6300_evb_pico2_defconfig
```kconfig
#
# Copyright (c) 2026 SUZINEE <suzinee@gmail.com>
#
# SPDX-License-Identifier: Apache-2.0
#

CONFIG_SYS_CLOCK_HW_CYCLES_PER_SEC=125000000
CONFIG_GPIO=y
CONFIG_UART_CONSOLE=y
CONFIG_PINCTRL=y
CONFIG_SPI=y
CONFIG_CONSOLE=y
CONFIG_SERIAL=y
CONFIG_BUILD_OUTPUT_UF2=y
```

## drivers/ethernet/Kconfig.w6300
```kconfig
# W6300 Ethernet driver
#
# Copyright (c) 2026 SUZINEE
#
# SPDX-License-Identifier: Apache-2.0

config ETH_W6300
	bool "W6300 Ethernet driver"
	default y
	depends on DT_HAS_WIZNET_W6300_ENABLED
	select SPI
	select ETH_W6300_PHY
	help
	  Enable W6300 Ethernet driver.

if ETH_W6300

config ETH_W6300_RX_THREAD_STACK_SIZE
	int "W6300 RX thread stack size"
	default 2048
	help
	  Stack size for the W6300 RX thread.

config ETH_W6300_RX_THREAD_PRIO
	int "W6300 RX thread priority"
	default 2
	help
	  Priority for the W6300 RX thread.

config ETH_W6300_MONITOR_PERIOD
	int "W6300 monitor period"
	default 250
	help
	  W6300 monitor period in milliseconds.

config ETH_W6300_TIMEOUT
	int "W6300 timeout"
	default 100
	help
	  W6300 timeout in milliseconds.

config ETH_W6300_PHY
	bool "W6300 internal PHY"
	default y
	help
	  Enable W6300 internal PHY.
	  

endif
```

## drivers/spi/Kconfig.silabs_siwx91x_gspi
```kconfig
# Copyright (c) 2025 Silicon Laboratories Inc.
# SPDX-License-Identifier: Apache-2.0

config SPI_SILABS_SIWX91X_GSPI
	bool "Silabs GSPI SPI Primary controller driver"
	default y
	select GPIO
	select PINCTRL
	depends on DT_HAS_SILABS_GSPI_ENABLED && CLOCK_CONTROL && SPI

if SPI_SILABS_SIWX91X_GSPI

config SPI_SILABS_SIWX91X_GSPI_DMA
	bool "DMA Support"
	select DMA
	help
	  Enable DMA support for SIWX91X MCU GSPI driver.

config SPI_SILABS_SIWX91X_GSPI_DMA_MAX_BLOCKS
	int "Maximum DMA transfer block per channel for a transaction."
	depends on SPI_SILABS_SIWX91X_GSPI_DMA
	default 16
	help
	  One block is needed for every chunk found in the SPI transaction and every 1024 bytes

endif # SPI_SILABS_SIWX91X_GSPI
```

## soc/riscv/raspberrypi_rp2/Kconfig.soc
```kconfig
# Copyright (c) 2026 SUZINEE
# SPDX-License-Identifier: Apache-2.0

config SOC_FAMILY_RPI_RP2
	bool
	help
	  Raspberry Pi RP2 SoC Family

if SOC_FAMILY_RPI_RP2

source "soc/riscv/raspberrypi_rp2/rp2350/Kconfig.soc"

source "soc/riscv/raspberrypi_rp2/rp2350/Kconfig"

endif # SOC_FAMILY_RPI_RP2
```

## soc/riscv/raspberrypi_rp2/rp2350/Kconfig
```kconfig
# Raspberry Pi RP2350 MCU line

# Copyright (c) 2026 SUZINEE
# SPDX-License-Identifier: Apache-2.0

config SOC_SERIES_RP2350
	select RISCV
	select RISCV_HAS_PLIC
	select XIP
	select HAS_RPI_RP2
	select HAS_SEGGER_RTT if ZEPHYR_SEGGER_MODULE
	help
	  Enable support for Raspberry Pi RP2350 MCU series

if SOC_SERIES_RP2350

config RP2_REQUIRES_SECOND_STAGE_BOOT
	bool
	default y if FLASH_LOAD_OFFSET = 0x100

# Flash type used by the SoC. The board should select the one used.

config RP2_FLASH_W25Q080
	bool
	help
	  Configure RP2 to use a W25Q080 flash chip, or similar. Should be selected
	  by the board definition, not the user.

endif
```

## soc/riscv/raspberrypi_rp2/rp2350/Kconfig.soc
```kconfig
# Copyright (c) 2026 SUZINEE
# SPDX-License-Identifier: Apache-2.0

menu "Raspberry Pi RP2350 configuration"
	depends on SOC_RP2350

config SOC_RP2350_PART_NUMBER
	string
	default "RP2350"

endmenu
```

## tests/drivers/ethernet/w6300/testcase.yaml
```yaml
tests:
  drivers.ethernet.w6300:
    arch_allow: riscv32
    platform_allow: w6300_evb_pico2/rp2350a/hazard3
    tags: drivers ethernet
```
